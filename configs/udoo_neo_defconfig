## configs/udoo_neo_defconfig
```kconfig
CONFIG_ARM=y
CONFIG_ARCH_MX6=y
CONFIG_TARGET_UDOO_NEO=y
CONFIG_SYS_EXTRA_OPTIONS="IMX_CONFIG=board/udoo/neo/udoo_neo.cfg,MX6SX,DEFAULT_FDT_FILE="imx6sx-udoo-neo.dtb",DDR_MB=1024"
```
